## overlay/opt/yocto/conf/bblayers.conf
```bitbake
# POKY_BBLAYERS_CONF_VERSION is increased each time build/conf/bblayers.conf
# changes incompatibly
POKY_BBLAYERS_CONF_VERSION = "2"

BBPATH = "${TOPDIR}"
BBFILES ?= ""

BBLAYERS ?= " \
  /opt/yocto/poky/meta \
  /opt/yocto/poky/meta-poky \
  /opt/yocto/poky/meta-yocto-bsp \
  /opt/yocto/meta-raspberrypi \
  /opt/yocto/meta-openembedded/meta-oe \
  /opt/yocto/meta-openembedded/meta-python \
  /opt/yocto/meta-openembedded/meta-multimedia \
  /opt/yocto/meta-openembedded/meta-networking \
  /opt/yocto/meta-chipsee \
  "
```
